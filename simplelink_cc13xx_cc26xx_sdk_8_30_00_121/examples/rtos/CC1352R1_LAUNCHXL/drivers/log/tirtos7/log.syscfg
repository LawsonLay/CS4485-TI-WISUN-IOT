/*
 * Copyright (c) 2018-2024, Texas Instruments Incorporated
 * All rights reserved.
 *
 * Redistribution and use in source and binary forms, with or without
 * modification, are permitted provided that the following conditions
 * are met:
 *
 * *  Redistributions of source code must retain the above copyright
 *    notice, this list of conditions and the following disclaimer.
 *
 * *  Redistributions in binary form must reproduce the above copyright
 *    notice, this list of conditions and the following disclaimer in the
 *    documentation and/or other materials provided with the distribution.
 *
 * *  Neither the name of Texas Instruments Incorporated nor the names of
 *    its contributors may be used to endorse or promote products derived
 *    from this software without specific prior written permission.
 *
 * THIS SOFTWARE IS PROVIDED BY THE COPYRIGHT HOLDERS AND CONTRIBUTORS "AS IS"
 * AND ANY EXPRESS OR IMPLIED WARRANTIES, INCLUDING, BUT NOT LIMITED TO,
 * THE IMPLIED WARRANTIES OF MERCHANTABILITY AND FITNESS FOR A PARTICULAR
 * PURPOSE ARE DISCLAIMED. IN NO EVENT SHALL THE COPYRIGHT OWNER OR
 * CONTRIBUTORS BE LIABLE FOR ANY DIRECT, INDIRECT, INCIDENTAL, SPECIAL,
 * EXEMPLARY, OR CONSEQUENTIAL DAMAGES (INCLUDING, BUT NOT LIMITED TO,
 * PROCUREMENT OF SUBSTITUTE GOODS OR SERVICES; LOSS OF USE, DATA, OR PROFITS;
 * OR BUSINESS INTERRUPTION) HOWEVER CAUSED AND ON ANY THEORY OF LIABILITY,
 * WHETHER IN CONTRACT, STRICT LIABILITY, OR TORT (INCLUDING NEGLIGENCE OR
 * OTHERWISE) ARISING IN ANY WAY OUT OF THE USE OF THIS SOFTWARE,
 * EVEN IF ADVISED OF THE POSSIBILITY OF SUCH DAMAGE.
 */
// @cliArgs --board /ti/boards/CC1352R1_LAUNCHXL --rtos tirtos7

/*
 *  log.syscfg
 */
const Board             = scripting.addModule("/ti/drivers/Board");
const Power             = scripting.addModule("/ti/drivers/Power");
const LogModule         = scripting.addModule("/ti/log/LogModule");
const LogSinkUART       = scripting.addModule("/ti/log/LogSinkUART");

/* ======== Kernel Configuration ======== */
system.getScript("kernel_config_release.syscfg.js");
var board = system.deviceData.board.name;

/* Only import ITM module for supported boards */
var ITM;
if(!board.match(/CC23.0/)) {
	ITM = scripting.addModule("/ti/drivers/ITM");
}

/**
 * Create three log modules and route them to different log sinks.
 * This means that LogModule_App1 records will be routed to the log buffer
 * and LogModule_App2 records will be routed to ITM if the platform supports it
 */
LogModule.enable_VERBOSE = true;
LogModule.enable_INFO    = true;

var LogModule_App1 = LogModule.addInstance();
var LogModule_App2 = LogModule.addInstance();
var LogModule_App3 = LogModule.addInstance();
const LogSinkUART1 = LogSinkUART.addInstance();

LogModule_App1.$name = "LogModule_App1"
LogModule_App2.$name = "LogModule_App2"
LogModule_App3.$name = "LogModule_App3"
LogModule_App1.loggerSink = "/ti/log/LogSinkBuf"

LogModule_App1.enable_VERBOSE = true;
LogModule_App1.enable_INFO    = true;

LogModule_App2.enable_VERBOSE = true;
LogModule_App2.enable_INFO    = true;

LogModule_App3.enable_VERBOSE = true;
LogModule_App3.enable_INFO    = true;


LogModule_App2.loggerSink   = "/ti/log/LogSinkUART"
LogModule_App2.logger       = LogSinkUART1;

if(!board.match(/CC23.0/)) {
    LogModule_App3.loggerSink = "/ti/log/LogSinkITM"
}
else {
    LogModule_App3.loggerSink = "/ti/log/LogSinkBuf"
}

if (board.match(/CC13../) || board.match(/CC26../)) {
    /* For split launchpads use DIO16 as this is connected to auxiliary COM-port by default */
    if (board.match(/_EM_/)) {
        ITM.swoPin.$assign  = "DIO16";
    } else {
        ITM.swoPin.$assign  = "DIO18";
    }
}
else if(board.match(/CC27../)) {
    ITM.swoPin.swoResource.$assign = "DIO11";
    scripting.suppress("Connected to hardware*", ITM.swoPin, "swoResource");
}

if (board.match(/LP_EM_CC2745P10_SOCKET|LP_EM_CC2745R10_SOCKET/))
{
    LogSinkUART1.uart.uart.txPin.$assign = "boosterpack.4";
    scripting.suppress("Connected to hardware*", LogSinkUART1.uart.uart, "txPin");
}
else
{
    LogSinkUART1.uart.$hardware         = system.deviceData.board.components.XDS110UART;
}

var GPIO = scripting.addModule("/ti/drivers/GPIO");
var gpio = GPIO.addInstance();
gpio.$hardware = system.deviceData.board.components.LED0;
gpio.$name = "CONFIG_GPIO_LED_0";
gpio.initialOutputState = "High";
