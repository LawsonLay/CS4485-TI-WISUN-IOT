/*
 * Copyright (c) 2019, Texas Instruments Incorporated
 * All rights reserved.
 *
 * Redistribution and use in source and binary forms, with or without
 * modification, are permitted provided that the following conditions
 * are met:
 *
 * *  Redistributions of source code must retain the above copyright
 *    notice, this list of conditions and the following disclaimer.
 *
 * *  Redistributions in binary form must reproduce the above copyright
 *    notice, this list of conditions and the following disclaimer in the
 *    documentation and/or other materials provided with the distribution.
 *
 * *  Neither the name of Texas Instruments Incorporated nor the names of
 *    its contributors may be used to endorse or promote products derived
 *    from this software without specific prior written permission.
 *
 * THIS SOFTWARE IS PROVIDED BY THE COPYRIGHT HOLDERS AND CONTRIBUTORS "AS IS"
 * AND ANY EXPRESS OR IMPLIED WARRANTIES, INCLUDING, BUT NOT LIMITED TO,
 * THE IMPLIED WARRANTIES OF MERCHANTABILITY AND FITNESS FOR A PARTICULAR
 * PURPOSE ARE DISCLAIMED. IN NO EVENT SHALL THE COPYRIGHT OWNER OR
 * CONTRIBUTORS BE LIABLE FOR ANY DIRECT, INDIRECT, INCIDENTAL, SPECIAL,
 * EXEMPLARY, OR CONSEQUENTIAL DAMAGES (INCLUDING, BUT NOT LIMITED TO,
 * PROCUREMENT OF SUBSTITUTE GOODS OR SERVICES; LOSS OF USE, DATA, OR PROFITS;
 * OR BUSINESS INTERRUPTION) HOWEVER CAUSED AND ON ANY THEORY OF LIABILITY,
 * WHETHER IN CONTRACT, STRICT LIABILITY, OR TORT (INCLUDING NEGLIGENCE OR
 * OTHERWISE) ARISING IN ANY WAY OUT OF THE USE OF THIS SOFTWARE,
 * EVEN IF ADVISED OF THE POSSIBILITY OF SUCH DAMAGE.
 */
// @cliArgs --board /ti/boards/LP_CC2652RSIP --rtos tirtos7



/*
 *  dmm_zed_switch_remote_display.syscfg
 */

/* ======== RF Design ======== */
var rfDesign = scripting.addModule("ti/devices/radioconfig/rfdesign");
const rfDesignSettings = system.getScript("/ti/common/lprf_rf_design_settings.js").rfDesignSettings;
for(var setting in rfDesignSettings)
{
    rfDesign[setting] = rfDesignSettings[setting];
}

/* ======== CCFG ======== */
var CCFG  = scripting.addModule("/ti/devices/CCFG");
const ccfgSettings = system.getScript("/ti/common/lprf_ccfg_settings.js").ccfgSettings;
const deviceName = system.getScript("/ti/ti154stack/ti154stack_common.js").getLaunchPadFromDevice();

for(var setting in ccfgSettings)
{
    CCFG[setting] = ccfgSettings[setting];
}

// Update LF Clock Source for CC2652RB devices
if(deviceName.includes("RB"))
{
    CCFG.srcClkLF = "Derived from HF XOSC";
}

/* ======== AESCCM ======== */
var AESCCM = scripting.addModule("/ti/drivers/AESCCM");
var aesccm = AESCCM.addInstance();

/* ======== AESECB ======== */
var AESECB = scripting.addModule("/ti/drivers/AESECB");
var aesecb = AESECB.addInstance();

/* ======== ECDH ======== */
var ECDH = scripting.addModule("/ti/drivers/ECDH");
var ecdh = ECDH.addInstance();
ecdh.$name = "CONFIG_ECDH0"

/* ======== AESCTRDRBG ======== */
var AESCTRDRBG = scripting.addModule("/ti/drivers/AESCTRDRBG");
var aesctrdrbg = AESCTRDRBG.addInstance();
aesctrdrbg.$name = "CONFIG_AESCTRDRBG_0";

/* ======== UART ======== */
var UART    = scripting.addModule("/ti/drivers/UART2");
var uart1    = UART.addInstance();
uart1.$hardware           = system.deviceData.board.components.XDS110UART;
uart1.$name               = "CONFIG_DISPLAY_UART";

/* ========== BUTTON ========= */
var Button = scripting.addModule("/ti/drivers/apps/Button");

var Button1 = Button.addInstance();
Button1.$name = "CONFIG_BTN_LEFT";
Button1.$hardware = system.deviceData.board.components["BTN-1"];
Button1.gpioPin.$name = "CONFIG_GPIO_BTN1";
Button1.gpioPin.pull = "Pull Up";

var Button2 = Button.addInstance();
Button2.$name = "CONFIG_BTN_RIGHT";
Button2.$hardware = system.deviceData.board.components["BTN-2"];
Button2.gpioPin.$name = "CONFIG_GPIO_BTN2";
Button2.gpioPin.pull = "Pull Up";

/* ========= LED ============ */
var LED = scripting.addModule("/ti/drivers/apps/LED");

var LED1 = LED.addInstance();
LED1.$name = "CONFIG_LED_RED";
LED1.$hardware = system.deviceData.board.components.LED_RED;
LED1.dimmable = true;
LED1.pwmPin.$name = "CONFIG_PWM_RED";
LED1.pwmPin.timerObject.$name = "CONFIG_GPTIMER_0";
LED1.pwmPin.timerObject.pwmPinInstance.$name = "CONFIG_PIN_RLED";

var LED2 = LED.addInstance();
LED2.$name = "CONFIG_LED_GREEN";
LED2.$hardware = system.deviceData.board.components.LED_GREEN;
LED2.gpioPin.$name = "CONFIG_GPIO_GLED";
LED2.gpioPin.mode = "Output";

/* ======== NVS ======== */
var NVS = scripting.addModule("/ti/drivers/NVS");
var nvs_int = NVS.addInstance();
nvs_int.$name = "CONFIG_NVSINTERNAL";

if (deviceName.includes("R7") || deviceName.includes("P7"))
{
    nvs_int.internalFlash.regionBase = 0xAA000;
    nvs_int.internalFlash.regionSize = 0x4000;
}
else if (deviceName.includes("2674") || deviceName.includes("P10") || deviceName.includes("R10"))
{
    nvs_int.internalFlash.regionBase = 0xFD800;
    nvs_int.internalFlash.regionSize = 0x2800;
}
else
{
    nvs_int.internalFlash.regionBase = 0x52000;
    nvs_int.internalFlash.regionSize = 0x4000;
}


var nvs_ext = NVS.addInstance();
nvs_ext.nvsType = "External";
nvs_ext.$name = "CONFIG_NVSEXTERNAL";
nvs_ext.externalFlash.$name = "ti_drivers_nvs_NVSSPI25X0";
nvs_ext.externalFlash.regionSize = 0x100000;
nvs_ext.externalFlash.verifyBufferSize = 64;
nvs_ext.externalFlash.$hardware = system.deviceData.board.components.SPI_FLASH;

var NVSSPI25XDevice1 = nvs_ext.externalFlash.spiFlashDevice;
NVSSPI25XDevice1.$name = "CONFIG_NVS_SPI_0";
NVSSPI25XDevice1.slaveSelectPinInstance.$name = "CONFIG_GPIO_SPI_SS";
NVSSPI25XDevice1.slaveSelectPinInstance.mode = "Output";

/* ======== SPI ======== */
var SPI1 = NVSSPI25XDevice1.sharedSpiInstance;
SPI1.$name = "CONFIG_SPI_0";
SPI1.sclkPinInstance.$name = "CONFIG_PIN_SPI_SCLK";
SPI1.misoPinInstance.$name = "CONFIG_PIN_SPI_MISO";
SPI1.mosiPinInstance.$name = "CONFIG_PIN_SPI_MOSI";

/* ======== RF ======== */
var RF = scripting.addModule("/ti/drivers/RF");

/* if an antenna component exists, assign it to the rf instance */
if (system.deviceData.board && system.deviceData.board.components.RF) {
    RF.$hardware = system.deviceData.board.components.RF;
}

/* ======== TRNG ======== */
var TRNG = scripting.addModule("/ti/drivers/TRNG");
var trng1 = TRNG.addInstance();
var trng2 = TRNG.addInstance();

/* ======== Z-Stack ======== */
var zstack = scripting.addModule("/ti/zstack/zstack");

// Device Type - The logical device type for the ZigBee node.
zstack.deviceType = "zr";
zstack.deviceTypeReadOnly = true;
zstack.rf.rfDesign = rfDesignSettings.rfDesign;

/* ======== BLE ======== */
var ble = scripting.addModule("/ti/ble5stack/ble");
ble.rfDesign = rfDesignSettings.rfDesign;
ble.deviceRole = "PERIPHERAL_CFG";
ble.deviceName = "DMM ZR Light RD";
ble.addressMode = "ADDRMODE_PUBLIC";
ble.maxConnNum = 1;
ble.numOfAdvSets = 1;
ble.lockProject = true;
ble.oneLibSizeOpt = false;
ble.maxPDUSize = 255;
ble.numOfDefAdvSets = 1;

// Gap Advertising Flags
ble.advSet1.advData1.GAP_ADTYPE_FLAGS = true;
ble.advSet1.advData1.advertisingFlags = ["GAP_ADTYPE_FLAGS_BREDR_NOT_SUPPORTED","GAP_ADTYPE_FLAGS_GENERAL"];
// More 16-bit UUIDs available
ble.advSet1.advData1.GAP_ADTYPE_16BIT_MORE = true;
ble.advSet1.advData1.numOfUUIDs16More = 1;
ble.advSet1.advData1.UUID016More = 0x1190;
// Complete local name
ble.advSet1.scanRes1.GAP_ADTYPE_LOCAL_NAME_COMPLETE = true;
ble.advSet1.scanRes1.completeLocalName = "DMM ZR Light RD";
// Min and Max values of the connection interval - 2 octets Min, 2 octets Max (0xFFFF indicates no conn interval min or max)
ble.advSet1.scanRes1.GAP_ADTYPE_SLAVE_CONN_INTERVAL_RANGE = true;
// Min Connection Interval
ble.advSet1.scanRes1.minConnInterval = 100;
// Max Connection Interval
ble.advSet1.scanRes1.maxConnInterval = 130;
// TX Power Level
ble.advSet1.scanRes1.GAP_ADTYPE_POWER_LEVEL = true;

// Update Min Connection Interval (ms)
ble.connUpdateParamsPeripheral.reqMinConnInt = 100;
// Update Max Connection Interval (ms)
ble.connUpdateParamsPeripheral.reqMaxConnInt = 130;

/* ======== DMM ======== */
var dmm = scripting.addModule("/ti/dmm/dmm");

dmm.project = "ti_dmm_zr_switch_remote_display";
dmm.stackRoles = ["blePeripheral","zigbeeRouter"];
dmm.lockStackRoles = true;
dmm.projectStackConfiguration = ["ble", "zstack"];

dmm.numApplicationStates = 10;

dmm.applicationState0 = "ANY";
dmm.applicationState1 = "DMMPOLICY_BLE_IDLE";
dmm.applicationState2 = "DMMPOLICY_BLE_ADV";
dmm.applicationState3 = "DMMPOLICY_BLE_CONNECTING";
dmm.applicationState4 = "DMMPOLICY_BLE_HIGH_BANDWIDTH";
dmm.applicationState5 = "DMMPOLICY_BLE_CONNECTED";
dmm.applicationState6 = "DMMPOLICY_BLE_OAD";

dmm.applicationState7 = "DMMPOLICY_ZB_UNINIT";
dmm.applicationState8 = "DMMPOLICY_ZB_PROVISIONING";
dmm.applicationState9 = "DMMPOLICY_ZB_CONNECTED";

dmm.numPolicies = 3;

dmm.policy0.blePeripheral.applicationStates = ["applicationState6"];
dmm.policy0.zigbeeRouter.pause = "DMMPOLICY_PAUSED";
dmm.policy0.zigbeeRouter.applicationStates = ["applicationState0"];

dmm.policy1.blePeripheral.applicationStates = ["applicationState3", "applicationState4"];
dmm.policy1.blePeripheral.weight = 25;
dmm.policy1.blePeripheral.appliedActivity = ["DMMPOLICY_APPLIED_ACTIVITY_BLE_CONNECTION"];
dmm.policy1.zigbeeRouter.applicationStates = ["applicationState0"];

dmm.policy2.blePeripheral.applicationStates = ["applicationState0"];
dmm.policy2.zigbeeRouter.applicationStates = ["applicationState0"];
dmm.policy2.zigbeeRouter.weight = 1;

const Hwi = scripting.addModule("/ti/sysbios/family/arm/m3/Hwi");

/* ******* Add SYS/BIOS 7.x to the configuration ********* */

/* ================ Boot configuration ================ */
const Boot = scripting.addModule("/ti/sysbios/family/arm/cc26xx/Boot");
/*
 * This module contains family specific Boot APIs and configuration settings.
 * See the SYS/BIOS API guide for more information.
 */
/*!
 *  Include a default customer configuration (CCFG) structure, default is
 *  false.
 *  Set to true to link in the default CCFG data structure in driverlib.
 */
Boot.customerConfig = false;

/* ================ Clock configuration ================ */
const Clock = scripting.addModule("/ti/sysbios/knl/Clock");

/* ================ Additional configuration ================ */
/*
 * Add a few other commonly used modules.
 */
const Event = scripting.addModule("/ti/sysbios/knl/Event");

/*
 * When using Power and calibrateRCOSC is set to true, this should be set to 10.
 * The timer used by the Clock module supports TickMode_DYNAMIC. This enables us
 * to set the tick period to 10 us without generating the overhead of additional
 * interrupts.
 *
 * Note: The calibrateRCOSC parameter is set within the Power configuration
 *     structure in the "Board.c" file.
 */
Clock.tickPeriod = 10;
Clock.swiPriority = 4;

/* ================ Error configuration ================ */
const Error = scripting.addModule("/ti/sysbios/runtime/Error");
/*
 * This function is called to handle all raised errors, but unlike
 * Error.raiseHook, this function is responsible for completely handling the
 * error with an appropriately initialized Error_Block.
 *
 * Pick one:
 *  - Error_UNWIND
 *      Returns back to the caller
 *  - Error_SPIN
 *      Simple alternative that traps on a while(1) loop for minimized target
 *      footprint
 *      Using Error_UNWIND, the Error.raiseHook will NOT called.
 *  - Error_TERMINATE
 *      Calls System_abort()
 */
//Error.policy = "Error_UNWIND";
//Error.policy = "Error_TERMINATE";
Error.policy = "Error_SPIN";

/*
 * If set to a non-null value, the referenced function is always called when
 * an error is raised, even if the Error policy is TERMINATE. 
 *
 * Pick one:
 *  - Error.print (default)
 *      Errors are formatted and output via System_printf() for easier
 *      debugging.
 *  - Null
 *      Errors are not formatted or logged. This option reduces code footprint.
 *  - non-null function
 *      Errors invoke custom user function. See the Error module documentation
 *      for more details.
 */
//Error.raiseHook = Error.print;
Error.raiseHook = "NULL";
//Error.raiseHook = "myErrorFxn";

/* ================ Hwi configuration ================ */
/*
 * Checks for Hwi (system) stack overruns while in the Idle loop.
 *
 * Pick one:
 *  - true (default)
 *      Checks the top word for system stack overflows during the idle loop and
 *      raises an Error if one is detected.
 *  - false
 *      Disabling the runtime check improves runtime performance and yields a
 *      reduced flash footprint.
 */
//Hwi.checkStackFlag = true;
Hwi.checkStackFlag = false;

/*
 * The following options alter the system's behavior when a hardware exception
 * is detected.
 *
 * Pick one:
 *  - Hwi.enableException = true
 *      This option causes the default Hwi.excHandlerFunc function to fully
 *      decode an exception and dump the registers to the system console.
 *      This option raises errors in the Error module and displays the
 *      exception in ROV.
 *  - Hwi.enableException = false
 *      This option reduces code footprint by not decoding or printing the
 *      exception to the system console.
 *      It however still raises errors in the Error module and displays the
 *      exception in ROV.
 *  - Hwi.excHandlerFunc = null
 *      This is the most aggressive option for code footprint savings; but it
 *      can difficult to debug exceptions. It reduces flash footprint by
 *      plugging in a default while(1) trap when exception occur. This option
 *      does not raise an error with the Error module.
 */
Hwi.enableException = true;
//Hwi.enableException = false;
Hwi.excHandlerFunc = "Main_excHandler";

/*
 * Append any of the following settings to the nvicCCR array to enable the 
 * corresponding hardware exception:
 *  - DIV_0_TRP: Enables hardware exception when dividing by zero
 *  - UNALIGN_TRP: Enables hardware exceptions when accessing unaligned memory
 *
 */
 Hwi.nvicCCR = [];
//Hwi.nvicCCR = ["DIV_0_TRP"];
//Hwi.nvicCCR = [UNALIGN_TRP"];
//Hwi.nvicCCR = ["DIV_0_TRP","UNALIGN_TRP"];

/*
 * Number of interrupts supported by target device.
 */
Hwi.numInterrupts = 54;

/* ================ Idle configuration ================ */
const Idle       = scripting.addModule("/ti/sysbios/knl/Idle");
const powerIdle  = Idle.addInstance();

/*
 * The Idle module is used to specify a list of functions to be called when no
 * other tasks are running in the system.
 *
 * Functions added here will be run continuously within the idle task.
 *
 * Function signature:
 *     Void func(Void);
 */
powerIdle.$name   = "powerIdle";
powerIdle.idleFxn = "Power_idleFunc"; /* Add the Power module's idle function */

/* ================ Kernel (SYS/BIOS) configuration ================ */
const BIOS = scripting.addModule("/ti/sysbios/BIOS");
/*
 * Enable asserts in the BIOS library.
 *
 * Pick one:
 *  - true (default)
 *      Enables asserts for debugging purposes.
 *  - false
 *      Disables asserts for a reduced code footprint and better performance.
 *
 *  When using BIOS in ROM:
 *      This option must be set to false.
 */
//BIOS.assertsEnabled = true;
BIOS.assertsEnabled = false;

/*
 * Runtime instance creation enable flag.
 *
 * Pick one:
 *   - true (default)
 *      Allows Mod_create() and Mod_delete() to be called at runtime which
 *      requires a default heap for dynamic memory allocation.
 *   - false
 *      Reduces code footprint by disallowing Mod_create() and Mod_delete() to
 *      be called at runtime. Object instances are constructed via
 *      Mod_construct() and destructed via Mod_destruct().
 *
 *  When using BIOS in ROM:
 *      This option must be set to true.
 */
BIOS.runtimeCreatesEnabled = true;
//BIOS.runtimeCreatesEnabled = false;

/*
 * Enable logs in the BIOS library.
 *
 * Pick one:
 *  - true (default)
 *      Enables logs for debugging purposes.
 *  - false
 *      Disables logging for reduced code footprint and improved runtime
 *      performance.
 *
 *  When using BIOS in ROM:
 *      This option must be set to false.
 */
//BIOS.logsEnabled = true;
BIOS.logsEnabled = false;

BIOS.rtsGateType  = "BIOS_GateMutexPri";
BIOS.heapSize     = 0x00000000;
BIOS.heapType     = "HeapCallback";

/* ================ Semaphore configuration ================ */
const Semaphore = scripting.addModule("/ti/sysbios/knl/Semaphore");
/*
 * Enables global support for Task priority pend queuing.
 *
 * Pick one:
 *  - true (default)
 *      This allows pending tasks to be serviced based on their task priority.
 *  - false
 *      Pending tasks are services based on first in, first out basis.
 *
 *  When using BIOS in ROM:
 *      This option must be set to false.
 */
//Semaphore.supportsPriority = true;
Semaphore.supportsPriority = false;

/*
 * Allows for the implicit posting of events through the semaphore,
 * disable for additional code saving.
 *
 * Pick one:
 *  - true
 *      This allows the Semaphore module to post semaphores and events
 *      simultaneously.
 *  - false (default)
 *      Events must be explicitly posted to unblock tasks.
 *
 *  When using BIOS in ROM:
 *      This option must be set to false.
 */
//Semaphore.supportsEvents = true;
Semaphore.supportsEvents = false;

/* ================ Swi configuration ================ */
const Swi = scripting.addModule("/ti/sysbios/knl/Swi");
/*
 * A software interrupt is an object that encapsulates a function to be
 * executed and a priority. Software interrupts are prioritized, preempt tasks
 * and are preempted by hardware interrupt service routines.
 *
 * This module is included to allow Swi's in a users' application.
 */
/*
 * Reduce the number of swi priorities from the default of 16.
 * Decreasing the number of swi priorities yields memory savings.
 */
Swi.numPriorities = 6;

/* ================ System configuration ================ */
const System = scripting.addModule("/ti/sysbios/runtime/System");
/*
 * The Abort handler is called when the system exits abnormally.
 *
 * Pick one:
 *  - System_abortStd (default)
 *      Call the ANSI C Standard 'abort()' to terminate the application.
 *  - System_abortSpin
 *      A lightweight abort function that loops indefinitely in a while(1) trap
 *      function.
 *  - A custom abort handler
 *      A user-defined function. See the System module documentation for
 *      details.
 */
//System.abortFxn = "System_abortStd";
System.abortFxn = "System_abortSpin";
//System.abortFxn = "myAbortSystem";

/*
 * The Exit handler is called when the system exits normally.
 *
 * Pick one:
 *  - System_exitStd (default)
 *      Call the ANSI C Standard 'exit()' to terminate the application.
 *  - System_exitSpin
 *      A lightweight exit function that loops indefinitely in a while(1) trap
 *      function.
 *  - A custom exit function
 *      A user-defined function. See the System module documentation for
 *      details.
 */
//System.exitFxn = "System_exitStd";
System.exitFxn = "System_exitSpin";
//System.exitFxn = "myExitSystem";

/*
 * Minimize exit handler array in the System module. The System module includes
 * an array of functions that are registered with System_atexit() which is
 * called by System_exit().
 */
System.maxAtexitHandlers = 1;

/*
 * Enable System_printf() to display floats.  Use the longer '%f%$L%$S%$F'
 * if your code has SYS/BIOS instrumentation enabled (Asserts/Error/Log),
 * as is typical with the 'debug' profile.
 */
//System.extendedFormats = '%f%$L%$S%$F';
//System.extendedFormats = '%f%$S';

/*
 * The System.supportModule defines a low-level implementation of System
 * functions such as System_printf(), System_flush(), etc.
 *
 * Pick one pair:
 *  - SysMin
 *      This module maintains an internal configurable circular buffer that
 *      stores the output until System_flush() is called.
 *      The size of the circular buffer is set via SysMin.bufSize.
 *  - SysCallback
 *      SysCallback allows for user-defined implementations for System APIs.
 *      The SysCallback support module has a smaller code footprint and can be
 *      used to supply custom System_printf services.
 *      The default SysCallback functions point to stub functions. See the
 *      SysCallback module's documentation.
 */
//const SysMin = scripting.addModule("/ti/sysbios/runtime/SysMin");
//System.supportModule = "SysMin";
//SysMin.bufSize = 128;

System.supportModule = "SysCallback";
const SysCallback = scripting.addModule("/ti/sysbios/runtime/SysCallback");
//SysCallback.abortFxn = "myUserAbort";
//SysCallback.exitFxn  = "myUserExit";
//SysCallback.flushFxn = "myUserFlush";
//SysCallback.putchFxn = "myUserputch";
//SysCallback.readyFxn = "myUserReady";

/* ================ Task configuration ================ */
const Task = scripting.addModule("/ti/sysbios/knl/Task");
/*
 * Check task stacks for overflow conditions.
 *
 * Pick one:
 *  - true (default)
 *      Enables runtime checks for task stack overflow conditions during
 *      context switching ("from" and "to")
 *  - false
 *      Disables runtime checks for task stack overflow conditions.
 *
 *  When using BIOS in ROM:
 *      This option must be set to false.
 */
//Task.checkStackFlag = true;
Task.checkStackFlag = false;

/*
 * Set the default task stack size when creating tasks.
 *
 * The default is dependent on the device being used. Reducing the default stack
 * size yields greater memory savings.
 */
Task.defaultStackSize = 512;

/*
 * Enables the idle task.
 *
 * Pick one:
 *  - true (default)
 *      Creates a task with priority of 0 which calls idle hook functions. This
 *      option must be set to true to gain power savings provided by the Power
 *      module.
 *  - false
 *      No idle task is created. This option consumes less memory as no
 *      additional default task stack is needed.
 *      To gain power savings by the Power module without having the idle task,
 *      add Idle.run as the Task.allBlockedFunc.
 */
Task.enableIdleTask = true;
//Task.enableIdleTask = false;
//Task.allBlockedFunc = Idle.run;

/*
 * If Task.enableIdleTask is set to true, this option sets the idle task's
 * stack size.
 *
 * Reducing the idle stack size yields greater memory savings.
 */
Task.idleTaskStackSize = 512;

/*
 * Reduce the number of task priorities.
 * Decreasing the number of task priorities yield memory savings.
 */
Task.numPriorities = 6;


/* ================ GateMutexPri configuration ================ */
const GateMutexPri = scripting.addModule("/ti/sysbios/gates/GateMutexPri");
const GateMutex    = scripting.addModule("/ti/sysbios/gates/GateMutex");


/* ================ Memory configuration ================ */
const HeapCallback = scripting.addModule("/ti/sysbios/heaps/HeapCallback");

HeapCallback.initFxn            = 'osalHeapInitFxn';        // Call First When BIOS boot. Initialize the Heap Manager.
HeapCallback.allocInstFxn       = 'osalHeapAllocFxn';       // Call for allocating a buffer
HeapCallback.freeInstFxn        = 'osalHeapFreeFxn';        // Call for Freeing a buffer
HeapCallback.getStatsInstFxn    = 'osalHeapGetStatsFxn';    // Return Statistic on the Heap.
HeapCallback.isBlockingInstFxn  = 'osalHeapIsBlockingFxn';  // Return TRUE: This heap is always blocking ('Hwi Gate' like )

const Memory = scripting.addModule("/ti/sysbios/runtime/Memory");

/* ================ POSIX configuration ================ */
const POSIX = scripting.addModule("/ti/posix/tirtos/Settings");
