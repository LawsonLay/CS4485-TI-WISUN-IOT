/*
 * Copyright (c) 2020-2024, Texas Instruments Incorporated
 * All rights reserved.
 *
 * Redistribution and use in source and binary forms, with or without
 * modification, are permitted provided that the following conditions
 * are met:
 *
 * *  Redistributions of source code must retain the above copyright
 *    notice, this list of conditions and the following disclaimer.
 *
 * *  Redistributions in binary form must reproduce the above copyright
 *    notice, this list of conditions and the following disclaimer in the
 *    documentation and/or other materials provided with the distribution.
 *
 * *  Neither the name of Texas Instruments Incorporated nor the names of
 *    its contributors may be used to endorse or promote products derived
 *    from this software without specific prior written permission.
 *
 * THIS SOFTWARE IS PROVIDED BY THE COPYRIGHT HOLDERS AND CONTRIBUTORS "AS IS"
 * AND ANY EXPRESS OR IMPLIED WARRANTIES, INCLUDING, BUT NOT LIMITED TO,
 * THE IMPLIED WARRANTIES OF MERCHANTABILITY AND FITNESS FOR A PARTICULAR
 * PURPOSE ARE DISCLAIMED. IN NO EVENT SHALL THE COPYRIGHT OWNER OR
 * CONTRIBUTORS BE LIABLE FOR ANY DIRECT, INDIRECT, INCIDENTAL, SPECIAL,
 * EXEMPLARY, OR CONSEQUENTIAL DAMAGES (INCLUDING, BUT NOT LIMITED TO,
 * PROCUREMENT OF SUBSTITUTE GOODS OR SERVICES; LOSS OF USE, DATA, OR PROFITS;
 * OR BUSINESS INTERRUPTION) HOWEVER CAUSED AND ON ANY THEORY OF LIABILITY,
 * WHETHER IN CONTRACT, STRICT LIABILITY, OR TORT (INCLUDING NEGLIGENCE OR
 * OTHERWISE) ARISING IN ANY WAY OUT OF THE USE OF THIS SOFTWARE,
 * EVEN IF ADVISED OF THE POSSIBILITY OF SUCH DAMAGE.
 */
// @cliArgs --board /ti/boards/CC1352P_4_LAUNCHXL --rtos freertos

/*
 *  itmwrite.syscfg
 */
var Power = scripting.addModule("/ti/drivers/Power");

var board = system.deviceData.board.name;

/* ======== Kernel Configuration ======== */
system.getScript("kernel_config_release.syscfg.js");

/* ======== GPIO ======== */
var GPIO = scripting.addModule("/ti/drivers/GPIO");
var gpio = GPIO.addInstance();
gpio.$hardware = system.deviceData.board.components.LED0;
gpio.$name = "CONFIG_GPIO_LED_0";

/* ======== ITM ======== */
var ITM = scripting.addModule("/ti/drivers/ITM");
/* Set baud rate (default: 12 Mbaud) */
ITM.baudRate = 12000000;

if (board.match(/CC13../) || board.match(/CC26../)) {
    if (board.match(/CC13.4/) || board.match(/CC26.[34]/)) {
        /* CC13X4, CC26X4 and CC26X3 requires an active debug session.
         * During an active debug session the TDO aux pin is used for the aux
         * COM port. DIO16 is the TDO pin.
         */
        ITM.swoPin.$assign  = "DIO16";
    } else {
        /* For other devices, the README file instructs users to end the debug
         * session. Which will cause the XDS to use the SWO signal for the aux
         * COM port. DIO18 is connected to the SWO signal.
         */
        ITM.swoPin.$assign  = "DIO18";
    }
}
else if(board.match(/CC27../)) {

    ITM.swoPin.swoResource.$assign = "DIO11";
    scripting.suppress("Connected to hardware*", ITM.swoPin, "swoResource");
}
