/*
 * Copyright (c) 2018-2024, Texas Instruments Incorporated
 * All rights reserved.
 *
 * Redistribution and use in source and binary forms, with or without
 * modification, are permitted provided that the following conditions
 * are met:
 *
 * *  Redistributions of source code must retain the above copyright
 *    notice, this list of conditions and the following disclaimer.
 *
 * *  Redistributions in binary form must reproduce the above copyright
 *    notice, this list of conditions and the following disclaimer in the
 *    documentation and/or other materials provided with the distribution.
 *
 * *  Neither the name of Texas Instruments Incorporated nor the names of
 *    its contributors may be used to endorse or promote products derived
 *    from this software without specific prior written permission.
 *
 * THIS SOFTWARE IS PROVIDED BY THE COPYRIGHT HOLDERS AND CONTRIBUTORS "AS IS"
 * AND ANY EXPRESS OR IMPLIED WARRANTIES, INCLUDING, BUT NOT LIMITED TO,
 * THE IMPLIED WARRANTIES OF MERCHANTABILITY AND FITNESS FOR A PARTICULAR
 * PURPOSE ARE DISCLAIMED. IN NO EVENT SHALL THE COPYRIGHT OWNER OR
 * CONTRIBUTORS BE LIABLE FOR ANY DIRECT, INDIRECT, INCIDENTAL, SPECIAL,
 * EXEMPLARY, OR CONSEQUENTIAL DAMAGES (INCLUDING, BUT NOT LIMITED TO,
 * PROCUREMENT OF SUBSTITUTE GOODS OR SERVICES; LOSS OF USE, DATA, OR PROFITS;
 * OR BUSINESS INTERRUPTION) HOWEVER CAUSED AND ON ANY THEORY OF LIABILITY,
 * WHETHER IN CONTRACT, STRICT LIABILITY, OR TORT (INCLUDING NEGLIGENCE OR
 * OTHERWISE) ARISING IN ANY WAY OUT OF THE USE OF THIS SOFTWARE,
 * EVEN IF ADVISED OF THE POSSIBILITY OF SUCH DAMAGE.
 */
// @cliArgs --board /ti/boards/LP_CC1352P7_4 --rtos freertos

/*
 *  spiperipheral.syscfg
 */

/* ======== Kernel Configuration ======== */
system.getScript("kernel_config_release.syscfg.js");

/* ======== Board ======== */
var board = system.deviceData.board.name;

/* ======== Display ======== */
var Display = scripting.addModule("/ti/display/Display");
var display = Display.addInstance();
display.$hardware = system.deviceData.board.components.XDS110UART;

/* ======== GPIO ======== */
var GPIO = scripting.addModule("/ti/drivers/GPIO");

if (!board.match(/CC35/)) {
    var gpio0 = GPIO.addInstance();
    gpio0.$hardware = system.deviceData.board.components.LED0;
    gpio0.$name = "CONFIG_GPIO_LED_0";

    var gpio1 = GPIO.addInstance();
    gpio1.$hardware = system.deviceData.board.components.LED1;
    gpio1.$name = "CONFIG_GPIO_LED_1";
}

var gpio2 = GPIO.addInstance();
gpio2.$name = "CONFIG_SPI_CONTROLLER_READY";

var gpio3 = GPIO.addInstance();
gpio3.$name = "CONFIG_SPI_PERIPHERAL_READY";

/* ======== SPI ======== */
var SPI = scripting.addModule("/ti/drivers/SPI");

var spi0 = SPI.addInstance();
spi0.$name = "CONFIG_SPI_PERIPHERAL";
spi0.mode = "Four Pin CS Active Low";

if (board.match(/CC13|CC26/)) {
    if (board.match(/CC1352[PR]|CC2652[PR]SIP|CC2651P|CC1311|CC1354|CC1314|CC2674|CC2653|CC2651R3SIPA|CC1312P/)) {
        gpio2.$hardware = system.deviceData.board.components.BUTTON0;
    }
    else {
        gpio2.gpioPin.$assign = "DIO15";
    }
    gpio3.gpioPin.$assign = "DIO21";

    spi0.$hardware = system.deviceData.board.components.LP_SPI;
    spi0.defaultTxBufferValue = "0xFF";
}
else if (board.match(/CC23/) || board.match(/CC27/)) {
    gpio2.$hardware = system.deviceData.board.components.BUTTON0;
    if (board.match(/CC23/)) {
        gpio3.gpioPin.$assign = "DIO8";
    } else if (board.match(/CC27/)) {
        gpio3.gpioPin.$assign = "DIO28_A0";
    }

    spi0.$hardware = system.deviceData.board.components.LP_SPI;
    spi0.defaultTxBufferValue = "0xFF";

}
else if (board.match(/CC35.*FPGA/)) {
    gpio3.gpioPin.$assign = "GPIO28";
    scripting.suppress("Connected to hardware.*", gpio3, "gpioPin");
    spi0.$hardware = system.deviceData.board.components.LP_SPI;
    spi0.defaultTxBufferValue = "0xFF";
}
else if (board.match(/CC35.*LAUNCHXL/)) {
    gpio3.gpioPin.$assign = "GPIO28";
    scripting.suppress("Connected to hardware.*", gpio3, "gpioPin");
    spi0.$hardware = system.deviceData.board.components.LP_SPI1;
    spi0.defaultTxBufferValue = "0xFF";
}

if(system.deviceData.deviceId.match(/CC35.*/)) {
    var ActionReq = scripting.addModule("/sysconfig/cc35xx/Action/ActionReq");
    ActionReq.primary_vendor_image = true;
    ActionReq.primary_vendor_image_validate = false;
}
