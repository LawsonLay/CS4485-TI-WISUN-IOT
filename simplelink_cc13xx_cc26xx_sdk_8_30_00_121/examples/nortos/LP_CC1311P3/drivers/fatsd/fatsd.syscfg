/*
 * Copyright (c) 2018-2024, Texas Instruments Incorporated
 * All rights reserved.
 *
 * Redistribution and use in source and binary forms, with or without
 * modification, are permitted provided that the following conditions
 * are met:
 *
 * *  Redistributions of source code must retain the above copyright
 *    notice, this list of conditions and the following disclaimer.
 *
 * *  Redistributions in binary form must reproduce the above copyright
 *    notice, this list of conditions and the following disclaimer in the
 *    documentation and/or other materials provided with the distribution.
 *
 * *  Neither the name of Texas Instruments Incorporated nor the names of
 *    its contributors may be used to endorse or promote products derived
 *    from this software without specific prior written permission.
 *
 * THIS SOFTWARE IS PROVIDED BY THE COPYRIGHT HOLDERS AND CONTRIBUTORS "AS IS"
 * AND ANY EXPRESS OR IMPLIED WARRANTIES, INCLUDING, BUT NOT LIMITED TO,
 * THE IMPLIED WARRANTIES OF MERCHANTABILITY AND FITNESS FOR A PARTICULAR
 * PURPOSE ARE DISCLAIMED. IN NO EVENT SHALL THE COPYRIGHT OWNER OR
 * CONTRIBUTORS BE LIABLE FOR ANY DIRECT, INDIRECT, INCIDENTAL, SPECIAL,
 * EXEMPLARY, OR CONSEQUENTIAL DAMAGES (INCLUDING, BUT NOT LIMITED TO,
 * PROCUREMENT OF SUBSTITUTE GOODS OR SERVICES; LOSS OF USE, DATA, OR PROFITS;
 * OR BUSINESS INTERRUPTION) HOWEVER CAUSED AND ON ANY THEORY OF LIABILITY,
 * WHETHER IN CONTRACT, STRICT LIABILITY, OR TORT (INCLUDING NEGLIGENCE OR
 * OTHERWISE) ARISING IN ANY WAY OUT OF THE USE OF THIS SOFTWARE,
 * EVEN IF ADVISED OF THE POSSIBILITY OF SUCH DAMAGE.
 */
// @cliArgs --board /ti/boards/LP_CC1311P3 --rtos nortos

/*
 *  fatsd.syscfg
 */

/* ======== Board ======== */
var board = system.deviceData.board.name;

/* ======== SD BoosterPack ======== */
if (!(board.match(/LP_CC2652PSIP/))) {
    var SD_BOOST = scripting.addHardware("/ti/boards/boosterpacks/BOOSTXL-SHARP128");
}

/* ======== Kernel Configuration ======== */
system.getScript("kernel_config_release.syscfg.js");

/* ======== Display ======== */
var Display = scripting.addModule("/ti/display/Display");
var displayUART = Display.addInstance();
displayUART.$hardware = system.deviceData.board.components.XDS110UART;

/* ======== GPIO ======== */
var GPIO = scripting.addModule("/ti/drivers/GPIO");
var gpio = GPIO.addInstance();
gpio.$hardware = system.deviceData.board.components.LED0;
gpio.$name = "CONFIG_GPIO_LED_0";

/* ======== SD ======== */
var SD = scripting.addModule("/ti/drivers/SD");
var sd = SD.addInstance();
sd.useFatFS = true;
sd.$name = "CONFIG_SDFatFS_0";

if (board.match(/LP_EM_CC2340R5_Q1/)) {
    /* LP_EM_CC2340R5_Q1 boards do not have a DIO connected to BP.8, so the 
     * Chip Select signal needs to be jumpered from BP.27 instead.
     *
     * Note: BP.28 is not used because no GPIO is connected to it and
     * BP.9 is not used because it would depend on the jumper settings on the
     * board.
     */
    sd.sdCSPin.$assign = "boosterpack.27";
    /* Set the child SPI instance to use the default LP SPI bus */
    sd.spiInstance.$hardware = system.deviceData.board.components.LP_SPI;
}
else if (board.match(/LP_CC2652PSIP/) || board.match(/LP_EM_CC1312PSIP/) || board.match(/LP_EM_CC2340R5/)) {
    /* LP_CC2652PSIP, LP_EM_CC1312PSIP and LP_EM_CC2340R5 boards do not
     * have a DIO connected to BP.8, so the Chip Select signal needs to be
     * jumpered from BP.28 instead.
     */
    sd.sdCSPin.$assign = "boosterpack.28";
    /* Set the child SPI instance to use the default LP SPI bus */
    sd.spiInstance.$hardware = system.deviceData.board.components.LP_SPI;
}
else if (board.match(/CC27/)) {
    /* CC27XX boards do not have a DIO connected to BP.8 nor BP.28, so the
     * Chip Select signal needs to be jumpered from BP.9 instead.
     */
    sd.sdCSPin.$assign = "boosterpack.9";
    /* Set the child SPI instance to use the default LP SPI bus */
    sd.spiInstance.$hardware = system.deviceData.board.components.LP_SPI;
}
else if (board === "LP_EM_CC2674P10") {
    /* The LP_EM_CC2674P10 board does not have a DIO connected to BP.8, so the
     * alternative Chip Select pin on BP.12 (SD_CD*) will be used instead.
     */
    sd.sdCSPin.$assign = "boosterpack.12";
    /* Set the child SPI instance to use the default LP SPI bus */
    sd.spiInstance.$hardware = system.deviceData.board.components.LP_SPI;

    /* Suppress warning that BP.12 is connected to BTN-2. This is acceptable
     * because the button is not used in this example
     */
    scripting.suppress("Connected to hardware*", sd, "sdCSPin");
}
else {
    sd.$hardware = SD_BOOST.components.SD_CARD;
}
