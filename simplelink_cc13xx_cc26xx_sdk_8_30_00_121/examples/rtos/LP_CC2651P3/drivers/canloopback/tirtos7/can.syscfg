/*
 * Copyright (c) 2023, Texas Instruments Incorporated
 * All rights reserved.
 *
 * Redistribution and use in source and binary forms, with or without
 * modification, are permitted provided that the following conditions
 * are met:
 *
 * *  Redistributions of source code must retain the above copyright
 *    notice, this list of conditions and the following disclaimer.
 *
 * *  Redistributions in binary form must reproduce the above copyright
 *    notice, this list of conditions and the following disclaimer in the
 *    documentation and/or other materials provided with the distribution.
 *
 * *  Neither the name of Texas Instruments Incorporated nor the names of
 *    its contributors may be used to endorse or promote products derived
 *    from this software without specific prior written permission.
 *
 * THIS SOFTWARE IS PROVIDED BY THE COPYRIGHT HOLDERS AND CONTRIBUTORS "AS IS"
 * AND ANY EXPRESS OR IMPLIED WARRANTIES, INCLUDING, BUT NOT LIMITED TO,
 * THE IMPLIED WARRANTIES OF MERCHANTABILITY AND FITNESS FOR A PARTICULAR
 * PURPOSE ARE DISCLAIMED. IN NO EVENT SHALL THE COPYRIGHT OWNER OR
 * CONTRIBUTORS BE LIABLE FOR ANY DIRECT, INDIRECT, INCIDENTAL, SPECIAL,
 * EXEMPLARY, OR CONSEQUENTIAL DAMAGES (INCLUDING, BUT NOT LIMITED TO,
 * PROCUREMENT OF SUBSTITUTE GOODS OR SERVICES; LOSS OF USE, DATA, OR PROFITS;
 * OR BUSINESS INTERRUPTION) HOWEVER CAUSED AND ON ANY THEORY OF LIABILITY,
 * WHETHER IN CONTRACT, STRICT LIABILITY, OR TORT (INCLUDING NEGLIGENCE OR
 * OTHERWISE) ARISING IN ANY WAY OUT OF THE USE OF THIS SOFTWARE,
 * EVEN IF ADVISED OF THE POSSIBILITY OF SUCH DAMAGE.
 */
// @cliArgs --board /ti/boards/LP_CC2651P3 --rtos tirtos7

/*
 *  can.syscfg
 */

const board = system.deviceData.board.name;

/* ======== Kernel Configuration ======== */
system.getScript("kernel_config_release.syscfg.js");

/* ======== CAN ======== */
const CAN    = scripting.addModule("/ti/drivers/CAN");
const CAN1   = CAN.addInstance();
CAN1.nomBitRate        = 500000;
CAN1.canFDEnable       = true;
CAN1.brsEnable         = true;
CAN1.dataBitRate       = 1000000;
CAN1.txRingBufferSize  = 0;
CAN1.rxRingBufferSize  = 6;
CAN1.rejectNonMatching = false;

if (board.match(/CC27/))
{
    CAN1.interruptPriority = "4";
    CAN1.$hardware = system.deviceData.board.components.LP_CAN_BUS;
}
else
{
    /* ======== SPI ======== */
    const SPI       = scripting.addModule("/ti/drivers/SPI");
    const SPI1      = SPI.addInstance();
    SPI1.$hardware  = system.deviceData.board.components.LP_SPI_BUS;

    /* ======== TCAN455X ======== */
    CAN1.externalCAN.tcan455x.csPin.$assign     = "boosterpack.13"
    CAN1.externalCAN.tcan455x.sharedSpiInstance = SPI1;
    scripting.suppress("@@@.+?@@@", CAN1.externalCAN.tcan455x, "csPin");

    if (board.match(/CC23/))
    {
        CAN1.externalCAN.tcan455x.canIRQPin.$assign = "boosterpack.36"
    }
    else
    {
        CAN1.externalCAN.tcan455x.canIRQPin.$assign = "boosterpack.31"
    }
}

/* ======== GPIO ======== */
var GPIO = scripting.addModule("/ti/drivers/GPIO");
var gpio = GPIO.addInstance();
gpio.$hardware = system.deviceData.board.components.LED0;
gpio.$name = "CONFIG_GPIO_LED_0";

/* ======== UART2 ======== */
const UART2    = scripting.addModule("/ti/drivers/UART2");
const UART21   = UART2.addInstance();
UART21.$hardware        = system.deviceData.board.components.XDS110UART;
UART21.txRingBufferSize = 2048;
