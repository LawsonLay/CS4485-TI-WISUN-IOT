/**
 * @cliArgs --board "/ti/boards/LP_CC1352P7_1" --device "CC1352P7RGZ" --part "Default" --package "RGZ" --rtos "tirtos7" --product "simplelink_cc13xx_cc26xx_sdk@8.30.01.01"
 * @versions {"tool":"1.21.1+3772"}
 */

/**
 * Import the modules used in this configuration.
 */
const CCFG         = scripting.addModule("/ti/devices/CCFG");
const rfdesign     = scripting.addModule("/ti/devices/radioconfig/rfdesign");
const NVS          = scripting.addModule("/ti/drivers/NVS");
const NVS1         = NVS.addInstance();
const RF           = scripting.addModule("/ti/drivers/RF");
const TRNG         = scripting.addModule("/ti/drivers/TRNG", {}, false);
const TRNG1        = TRNG.addInstance();
const TRNG2        = TRNG.addInstance();
const UART2        = scripting.addModule("/ti/drivers/UART2", {}, false);
const UART21       = UART2.addInstance();
const Watchdog     = scripting.addModule("/ti/drivers/Watchdog", {}, false);
const Watchdog1    = Watchdog.addInstance();
const Button       = scripting.addModule("/ti/drivers/apps/Button");
const Button1      = Button.addInstance();
const Button2      = Button.addInstance();
const LED          = scripting.addModule("/ti/drivers/apps/LED");
const LED1         = LED.addInstance();
const LED2         = LED.addInstance();
const Settings     = scripting.addModule("/ti/posix/tirtos/Settings");
const BIOS         = scripting.addModule("/ti/sysbios/BIOS");
const Boot         = scripting.addModule("/ti/sysbios/family/arm/cc26xx/Boot");
const Hwi          = scripting.addModule("/ti/sysbios/family/arm/m3/Hwi");
const GateMutexPri = scripting.addModule("/ti/sysbios/gates/GateMutexPri");
const HeapCallback = scripting.addModule("/ti/sysbios/heaps/HeapCallback");
const Clock        = scripting.addModule("/ti/sysbios/knl/Clock");
const Event        = scripting.addModule("/ti/sysbios/knl/Event");
const Idle         = scripting.addModule("/ti/sysbios/knl/Idle");
const Idle1        = Idle.addInstance();
const Mailbox      = scripting.addModule("/ti/sysbios/knl/Mailbox");
const Semaphore    = scripting.addModule("/ti/sysbios/knl/Semaphore");
const Swi          = scripting.addModule("/ti/sysbios/knl/Swi");
const Task         = scripting.addModule("/ti/sysbios/knl/Task");
const Error        = scripting.addModule("/ti/sysbios/runtime/Error");
const Memory       = scripting.addModule("/ti/sysbios/runtime/Memory");
const SysCallback  = scripting.addModule("/ti/sysbios/runtime/SysCallback");
const System       = scripting.addModule("/ti/sysbios/runtime/System");
const ti_wisunfan  = scripting.addModule("/ti/ti_wisunfan/ti_wisunfan");

/**
 * Write custom configuration values to the imported modules.
 */
CCFG.xoscCapArray             = true;
CCFG.xoscCapArrayDelta        = 0xC1;
CCFG.enableBootloader         = true;
CCFG.enableBootloaderBackdoor = true;
CCFG.dioBootloaderBackdoor    = 15;
CCFG.levelBootloaderBackdoor  = "Active low";
CCFG.ccfgTemplate.$name       = "ti_devices_CCFG_CCFGCC26XXTemplate0";

NVS1.$name                    = "CONFIG_NVSINTERNAL";
NVS1.internalFlash.$name      = "ti_drivers_nvs_NVSCC26XX0";
NVS1.internalFlash.regionBase = 0xA8000;
NVS1.internalFlash.regionSize = 0x4000;

RF.$hardware = system.deviceData.board.components["SKY13317-373LF"];

TRNG1.$name = "NANOSTACK_TRNG";

TRNG2.$name = "CONFIG_TRNG_0";

UART21.$name            = "CONFIG_UART2_0";
UART21.$hardware        = system.deviceData.board.components.XDS110UART;
UART21.rxRingBufferSize = 128;
UART21.txRingBufferSize = 128;

Watchdog1.$name = "CONFIG_WATCHDOG_0";

Button1.$hardware     = system.deviceData.board.components["BTN-1"];
Button1.$name         = "CONFIG_BTN_LEFT";
Button1.gpioPin.$name = "CONFIG_GPIO_BTN1";
Button1.gpioPin.pull  = "Pull Up";

Button2.$hardware     = system.deviceData.board.components["BTN-2"];
Button2.$name         = "CONFIG_BTN_RIGHT";
Button2.gpioPin.$name = "CONFIG_GPIO_BTN2";
Button2.gpioPin.pull  = "Pull Up";

LED1.$hardware     = system.deviceData.board.components.LED_RED;
LED1.$name         = "CONFIG_LED_RED";
LED1.gpioPin.$name = "CONFIG_GPIO_RLED";

LED2.$hardware     = system.deviceData.board.components.LED_GREEN;
LED2.$name         = "CONFIG_LED_GREEN";
LED2.gpioPin.$name = "CONFIG_GPIO_GLED";

BIOS.assertsEnabled = false;
BIOS.rtsGateType    = "BIOS_GateMutexPri";
BIOS.heapSize       = 0x00000000;
BIOS.heapType       = "HeapCallback";

Hwi.nvicCCR = [];

HeapCallback.initFxn           = "osalHeapInitFxn";
HeapCallback.allocInstFxn      = "osalHeapAllocFxn";
HeapCallback.freeInstFxn       = "osalHeapFreeFxn";
HeapCallback.getStatsInstFxn   = "osalHeapGetStatsFxn";
HeapCallback.isBlockingInstFxn = "osalHeapIsBlockingFxn";

Clock.tickPeriod = 10;

const Timer = scripting.addModule("/ti/sysbios/family/arm/cc26xx/Timer", {}, false);

Idle1.$name   = "powerIdle";
Idle1.idleFxn = "Power_idleFunc";

Semaphore.supportsPriority = false;

Swi.numPriorities = 6;

Task.checkStackFlag    = false;
Task.defaultStackSize  = 512;
Task.idleTaskStackSize = 512;
Task.numPriorities     = 6;

SysCallback.putchFxn = "ns_put_char_blocking";

System.abortFxn          = "System_abortSpin";
System.exitFxn           = "System_exitSpin";
System.maxAtexitHandlers = 2;
System.extendedFormats   = "%f%$S";
System.supportModule     = "SysCallback";

ti_wisunfan.lockProject                        = true;
ti_wisunfan.rxOnIdle                           = true;
ti_wisunfan.panID                              = 0xABCD;
ti_wisunfan.genLibs                            = "macOnly";
ti_wisunfan.UseExternalDhcpServer              = true;
ti_wisunfan.radioConfig.$name                  = "ti_devices_radioconfig_settings_prop0";
ti_wisunfan.radioConfig.codeExportConfig.$name = "ti_devices_radioconfig_code_export_param0";
ti_wisunfan.aesccmModule.$name                 = "CONFIG_AESCCM_0";
ti_wisunfan.aesecbModule.$name                 = "CONFIG_AESECB_0";
ti_wisunfan.aescbcModule.$name                 = "CONFIG_AESCBC_0";

/**
 * Pinmux solution for unlocked pins/peripherals. This ensures that minor changes to the automatic solver in a future
 * version of the tool will not impact the pinmux you originally saw.  These lines can be completely deleted in order to
 * re-solve from scratch.
 */
RF.rfAntennaPin0.$suggestSolution   = "DIO_28";
RF.rfAntennaPin1.$suggestSolution   = "DIO_29";
RF.rfAntennaPin2.$suggestSolution   = "DIO_30";
UART21.uart.$suggestSolution        = "UART0";
UART21.uart.txPin.$suggestSolution  = "boosterpack.4";
UART21.uart.rxPin.$suggestSolution  = "boosterpack.3";
Watchdog1.watchdog.$suggestSolution = "WDT0";
Button1.button.$suggestSolution     = "boosterpack.13";
Button2.button.$suggestSolution     = "boosterpack.8";
LED1.ledPin.$suggestSolution        = "boosterpack.39";
LED2.ledPin.$suggestSolution        = "boosterpack.40";
Timer.rtc.$suggestSolution          = "RTC0";
